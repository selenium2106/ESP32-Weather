#include <WiFi.h>
#include <WiFiMulti.h>
#include <ArduinoJson.h>
#include <Wire.h>
#include <Adafruit_GFX.h>
#include <Adafruit_SSD1306.h>

// logo en bitmap
const unsigned char epd_bitmap_20231101_191851 [] PROGMEM = {
	0x00, 0x00, 0x00, 0x00, 0x00, 0x00, 0x00, 0x00, 0x00, 0x00, 0x00, 0x00, 0x00, 0x00, 0x00, 0x00, 
	0x00, 0x00, 0x00, 0x00, 0x00, 0x00, 0x00, 0x00, 0x00, 0x00, 0x00, 0x00, 0x00, 0x00, 0x00, 0x00, 
	0x00, 0x00, 0x00, 0x00, 0x00, 0x00, 0x00, 0x00, 0x00, 0x00, 0x00, 0x00, 0x00, 0x00, 0x00, 0x00, 
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	0x00, 0x00, 0x00, 0x00, 0x00, 0x00, 0x00, 0x00, 0x00, 0x00, 0x00, 0x00, 0x00, 0x00, 0x00, 0x00
};

// Array of all bitmaps for convenience. (Total bytes used to store images in PROGMEM = 1040)
const int epd_bitmap_allArray_LEN = 1;
const unsigned char* epd_bitmap_allArray[1] = {
	epd_bitmap_20231101_191851
};
//fin del logo

WiFiMulti wifiMulti;
Adafruit_SSD1306 display(128, 64, &Wire, -1);

const char* APIKEY = "ffbfa7f99ca8ddbee6a7d7ad199ac3ba";  // Clave API de OpenWeatherMap
String CityID = "3688928";  // ID de la ciudad que deseas consultar en OpenWeatherMap

WiFiClient client;
char servername[] = "api.openweathermap.org";
String result;

const uint32_t TiempoEsperaWifi = 5000;

void setup() {
 
  Serial.begin(115200);
  Serial.println("\nIniciando multi WiFi");
  display.begin(SSD1306_SWITCHCAPVCC, 0x3C);
  delay(200);
// Dibuja el logo en pantalla por 2 segundos
  display.clearDisplay();
  display.drawBitmap(0, 0, epd_bitmap_20231101_191851, 128, 64, SSD1306_WHITE);
  display.display();
  delay(2000);
  display.clearDisplay();
  display.display();

//lista de redes guardadas, cuantas mas mejor
  wifiMulti.addAP("tu wifi", "tu contraseña");
  wifiMulti.addAP("tu wifi2", "tu contraseña2");
  

  WiFi.mode(WIFI_STA);
 
  display.clearDisplay();
  display.setTextSize(1);
  display.setTextColor(SSD1306_WHITE);
  display.setCursor(0, 0);
  display.print("Conectando.");
  Serial.print("Conectando.");
  display.display();
  
  while (wifiMulti.run(TiempoEsperaWifi) != WL_CONNECTED) {
    delay(500);
    Serial.print(".");
    display.print(".");
    display.display();
  }
  Serial.println("Conectado");
  Serial.print("SSID:");
  Serial.print(WiFi.SSID());
  Serial.print(" ID:");
  Serial.println(WiFi.localIP());
  display.clearDisplay();
  display.setCursor(0, 0);
  display.println("conectado a: ");
  display.println(WiFi.SSID());
  display.println(" ");
  display.println("Direccion IP: ");
  display.println(WiFi.localIP());
  display.display();
  delay(1000);
  display.clearDisplay();
}


void loop() {
  if (client.connect(servername, 80)) {
    client.println("GET /data/2.5/weather?id=" + CityID + "&units=metric&APPID=" + APIKEY);
    client.println("Host: api.openweathermap.org");
    client.println("User-Agent: ArduinoWiFi/1.1");
    client.println("Connection: close");
    client.println();
  } else {
    Serial.println("Conexión fallida");
  }

  while (client.connected() && !client.available())
    delay(1);

  while (client.connected() || client.available()) {
    char c = client.read();
    result = result + c;
  }

  client.stop();
  result.replace('[', ' ');
  result.replace(']', ' ');

  char jsonArray[result.length() + 1];
  result.toCharArray(jsonArray, sizeof(jsonArray));
  jsonArray[result.length() + 1] = '\0';

  StaticJsonDocument<1024> doc;
  DeserializationError error = deserializeJson(doc, jsonArray);

  if (error) {
    Serial.print(F("deserializeJson() falló con el código "));
    Serial.println(error.c_str());
    return;
  }

  String location = doc["name"];
  String country = doc["sys"]["country"];
  int temperature = doc["main"]["temp"];
  int humidity = doc["main"]["humidity"];
  float pressure = doc["main"]["pressure"];
  int id = doc["id"];
  float Speed = doc["wind"]["speed"];
  int degree = doc["wind"]["deg"];
  float longitude = doc["coord"]["lon"];
  float latitude = doc["coord"]["lat"];

  Serial.println();
  Serial.print("País: ");
  Serial.println(country);
  Serial.print("Ubicación: ");
  Serial.println(location);
  Serial.print("ID de ubicación: ");
  Serial.println(id);
  Serial.printf("Temperatura: %d°C\r\n", temperature);
  Serial.printf("Humedad: %d %%\r\n", humidity);
  Serial.printf("Presión: %.2f hPa\r\n", pressure);
  Serial.printf("Velocidad del viento: %.1f m/s\r\n", Speed);
  Serial.printf("Dirección del viento: %d°\r\n", degree);
  Serial.printf("Longitud: %.2f\r\n", longitude);
  Serial.printf("Latitud: %.2f\r\n", latitude);

  display.clearDisplay();
  display.setCursor(0, 0);
  display.setTextColor(SSD1306_BLACK, SSD1306_WHITE);
  display.print(" Ubicacion: ");
  display.print(country);
  display.print(" ");
  display.println(location);

  display.println();
  display.setTextColor(SSD1306_WHITE, SSD1306_BLACK);
  display.print("Temp: ");
  display.print(temperature);
  display.print((char)247);
  display.println("C");
  display.print("Humedad: ");
  display.print(humidity);
  display.println("%");
  display.print("Presion: ");
  display.print(pressure);
  display.println("hPa");
  display.print("Vel. viento: ");
  display.print(Speed);
  display.println("m/s");
  display.print("Dir. viento: ");
  display.print(degree);
  display.print((char)247);

  display.display();

  delay(60000); // 10 minuto de espera antes de actualizar los datos nuevamente
}
